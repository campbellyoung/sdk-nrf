## CMakeLists.txt
```
cmake_minimum_required(VERSION 3.20.0)

find_package(Zephyr REQUIRED HINTS $ENV{ZEPHYR_BASE})
project(tfm_uicr_panic)

target_sources(app PRIVATE src/main.c)
```

## prj.conf
```kconfig
CONFIG_CONSOLE=y
CONFIG_PRINTK=y
CONFIG_SERIAL=y
CONFIG_UART_CONSOLE=y

CONFIG_LOG=n

CONFIG_MAIN_STACK_SIZE=2048
CONFIG_RESET_ON_FATAL_ERROR=n

CONFIG_BUILD_WITH_TFM=y
```

## tfm.conf
```kconfig
CONFIG_TFM_PROFILE_TYPE_NOT_SET=y
CONFIG_TFM_SFN=y
CONFIG_TFM_IPC=n
CONFIG_TFM_LOG_LEVEL_SILENCE=y
```

## src/main.c
```c
#include <stddef.h>
#include <stdint.h>

#include <nrfx.h>
#include <tfm_ioctl_core_api.h>
#include <zephyr/kernel.h>
#include <zephyr/sys/printk.h>

#define UICR_OTP_ADDR (NRF_UICR_S_BASE + offsetof(NRF_UICR_Type, OTP))

int main(void)
{
    uint32_t otp_words[2] = {0};
    uint32_t result = UINT32_MAX;
    enum tfm_platform_err_t err;

    printk("repro booted\n");

    err = tfm_platform_mem_read(otp_words, UICR_OTP_ADDR, sizeof(otp_words), &result);
    printk("otp-read err=%d result=%u word0=%08x word1=%08x\n",
           (int)err, result, otp_words[0], otp_words[1]);

    printk("about to panic...\n");
    k_panic();

    return 0;
}
```
